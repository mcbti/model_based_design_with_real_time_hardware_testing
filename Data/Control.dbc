VERSION ""

NS_ :

BS_:

BU_:

BO_ 20 Control: 1 Vector__XXX
 SG_ DutyCycle : 0|8@1+ (1,0) [0|100] "" Vector__XXX

BO_ 3221225472 VECTOR__INDEPENDENT_SIG_MSG: 0 Vector__XXX
 SG_ Setpoint : 8|8@1+ (1,0) [0|100] "" Vector__XXX

BO_ 60 IHM: 1 Vector__XXX
 SG_ Setpoint : 0|8@1+ (1,0) [0|100] "" Vector__XXX

BO_ 100 Powertrain: 1 Vector__XXX
 SG_ MotorSpeed : 0|8@1+ (1,0) [0|100] "rad/s" Vector__XXX
